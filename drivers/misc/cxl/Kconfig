## drivers/misc/cxl/Kconfig
```kconfig
#
# IBM Coherent Accelerator (CXL) compatible devices
#

config CXL_BASE
	bool
	default n
	select PPC_COPRO_BASE

config CXL_KERNEL_API
	bool
	default n

config CXL_EEH
	bool
	default n

config CXL
	tristate "Support for IBM Coherent Accelerators (CXL)"
	depends on PPC_POWERNV && PCI_MSI && EEH
	select CXL_BASE
	select CXL_KERNEL_API
	select CXL_EEH
	default m
	help
	  Select this option to enable driver support for IBM Coherent
	  Accelerators (CXL).  CXL is otherwise known as Coherent Accelerator
	  Processor Interface (CAPI).  CAPI allows accelerators in FPGAs to be
	  coherently attached to a CPU via an MMU.  This driver enables
	  userspace programs to access these accelerators via /dev/cxl/afuM.N
	  devices.

	  CAPI adapters are found in POWER8 based systems.

	  If unsure, say N.

config CXL_KVM
       bool "Enable KVM Guest support"
       default y
       select SPAPR_TCE_IOMMU
       select VFIO
       select KVM_VFIO
       select VFIO_PCI
       depends on CXL && KVM
       help
	Provides support for pci passthrough for KVM guests.
	CAPI adapters are found in POWER8 based systems.
	if unsure, say N.
```
